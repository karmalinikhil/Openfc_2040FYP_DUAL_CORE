## PX4-Autopilot/src/drivers/imu/st/lsm6ds3/Kconfig
```kconfig
menuconfig DRIVERS_IMU_ST_LSM6DS3
	bool "lsm6ds3"
	default n
	---help---
		Enable support for ST LSM6DS3TR-C IMU (6-axis accel/gyro)
```

## PX4-Autopilot/src/drivers/lights/rgbled_gpio/Kconfig
```kconfig
menuconfig DRIVERS_LIGHTS_RGBLED_GPIO
	bool "rgbled_gpio"
	default n
	---help---
		Enable support for GPIO-based RGB LED
```
